## config/west.yml
```yaml
manifest:
  remotes:
    - name: zmkfirmware
      url-base: https://github.com/zmkfirmware
    - name: Topher083                        # new entry
      url-base: https://github.com/Topher083 #new entry
  projects:
    - name: zmk
      remote: zmkfirmware
      revision: v0.3
      import: app/west.yml
    - name: nice-view-gem                # new entry, the repository name of the module
      remote: Topher083                      # new entry
      revision: main                            # new entry
  self:
    path: config
```
